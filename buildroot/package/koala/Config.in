## buildroot/package/koala/Config.in
```kconfig
source "package/koala/power-mgr/Config.in"
source "package/koala/lvgl/Config.in"
source "package/koala/display-mgr/Config.in"
```

## buildroot/package/koala/display-mgr/Config.in
```kconfig
config BR2_PACKAGE_DISPLAY_MGR
    bool "display-mgr"
    select BR2_PACKAGE_LVGL
    help
      LVGL display manager service
```

## buildroot/package/koala/lvgl/Config.in
```kconfig
config BR2_PACKAGE_LVGL
    bool "lvgl"
    help
      LVGL graphics library v9.5.0
```

## buildroot/package/koala/power-mgr/Config.in
```kconfig
config BR2_PACKAGE_POWER_MGR
	bool "power manager"
	help
	  Power button manager.
```
